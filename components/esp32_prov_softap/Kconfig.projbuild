## components/esp32_prov_softap/Kconfig.projbuild
```kconfig
menu "SiX IoT Softap Configuration"

    config SDK_AP_SSID
        string "the ssid for the AP"
        default "ESP32-AP"
        help
            This is the example SSID for the AP.
            
    config SDK_AP_PASSWORD
        string "the password for the AP"
        default "12345678"
        help
            This is the password for the AP.
    
    config WIFI_CONNECTION_MAXIMUM_RETRY
        int "WiFi connection maximum retry"
        range 0 255
        default 2
        help
            WiFi connection maximum retry, from 0 to 255.

endmenu
```

## main/Kconfig.projbuild
```kconfig
menu "SiX IoT IF Configuration"
   	
   	config TRACE_MAIN_TASK_STACK
  		bool "Trace main task stack"
  		default false
   		help
    		This config is used to trace the main task stack
            
endmenu
```

## sdkconfig.defaults
```kconfig
#
# Partition Table
#
# CONFIG_PARTITION_TABLE_SINGLE_APP is not set
# CONFIG_PARTITION_TABLE_SINGLE_APP_LARGE is not set
# CONFIG_PARTITION_TABLE_TWO_OTA is not set
CONFIG_PARTITION_TABLE_CUSTOM=y
CONFIG_PARTITION_TABLE_CUSTOM_FILENAME="partitions-debug.csv"
CONFIG_PARTITION_TABLE_FILENAME="partitions-debug.csv"
CONFIG_PARTITION_TABLE_OFFSET=0x8000
CONFIG_PARTITION_TABLE_MD5=y
# end of Partition Table


#
# BT config
#
CONFIG_BT_ENABLED=y
CONFIG_BT_NIMBLE_ENABLED=y
CONFIG_BT_NIMBLE_BLUFI_ENABLE=y
CONFIG_BT_GATTC_ENABLE=n
CONFIG_BT_BLE_SMP_ENABLE=n
CONFIG_BT_BLE_BLUFI_ENABLE=y
CONFIG_MBEDTLS_HARDWARE_MPI=n
CONFIG_MBEDTLS_DHM_C=y

#
# SiX IoT IF Configuration
#
# CONFIG_ESP32_PROV_BLUFI=y
# CONFIG_ESP32_PROV_SOFTAP is not set
# CONFIG_TRACE_MAIN_TASK_STACK is not set
# end of SiX IoT IF Configuration

#
# SiX IoT SDK Configuration
#
CONFIG_SDK_DEVICE_GUID="96833890-63e5-4f7c-9851-1391d9784ef1"
CONFIG_SDK_TOKEN_ENDPOINT="https://iam.shuhenglianchang.com/oauth2/token"
CONFIG_SDK_MQTT_ENDPOINT="wss://shuhenglianchang.com:30084/mqtt"
CONFIG_SDK_SNTP_URL="ntp.aliyun.com"
CONFIG_SDK_PRODUCT_ID="655dcb820b3ad61dc370f697"
CONFIG_SDK_BIND_DEVICE_ENDPOINT="https://mgt.iot.shuhenglianchang.com/iot/product/%s/device/binding"
CONFIG_SDK_LOG_ENDPOINT="https://int.iot.shuhenglianchang.com/iot/log/product/%s"
CONFIG_SDK_ENABLE_CA=y
CONFIG_DEFAULT_ROOT_CA=y
# CONFIG_AWS_ROOT_CA is not set
CONFIG_DEFAULT_MQTT_BROKER=y
# CONFIG_AWS_MQTT_BROKER is not set
CONFIG_SDK_TOKEN_REQ_DEFAULT_CA=y
# CONFIG_SDK_TOKEN_REQ_AWS_CA is not set
CONFIG_SDK_BIND_DEVICE_REQ_DEFAULT_CA=y
# CONFIG_SDK_BIND_DEVICE_REQ_AWS_CA is not set
CONFIG_SDK_LOG_REQ_DEFAULT_CA=y
# CONFIG_SDK_LOG_REQ_AWS_CA is not set
CONFIG_SDK_OTA_REQ_DEFAULT_CA=y
# CONFIG_SDK_OTA_REQ_AWS_CA is not set
# end of SiX IoT SDK Configuration

#
# SiX IoT BluFi Configuration
#
CONFIG_WIFI_CONNECTION_MAXIMUM_RETRY=2
# end of SiX IoT BluFi Configuration

#
# SiX IoT Softap Configuration
#
CONFIG_SDK_AP_SSID="ESP32-AP"
CONFIG_SDK_AP_PASSWORD="12345678"
# end of SiX IoT Softap Configuration
```
